## Kconfig
```kconfig
menuconfig STAGING_PICOCALC
    bool "Picocalc staging drivers"
    default n
    help
      This option enables the drivers necessary to support the clockwork
      picocalc, e.g. keyboard and lcd drivers. These drivers were provided by
      hisptoot (https://github.com/hisptoot/picocalc_luckfox_lyra).

if STAGING_PICOCALC

source "drivers/staging/picocalc/picocalc_kbd/Kconfig"
source "drivers/staging/picocalc/picocalc_lcd_fb/Kconfig"
source "drivers/staging/picocalc/picocalc_lcd_drm/Kconfig"
source "drivers/staging/picocalc/picocalc_snd-pwm/Kconfig"
source "drivers/staging/picocalc/picocalc_snd-softpwm/Kconfig"
source "drivers/staging/picocalc/picocalc_mfd/Kconfig"
source "drivers/staging/picocalc/picocalc_mfd_bms/Kconfig"
source "drivers/staging/picocalc/picocalc_mfd_bkl/Kconfig"
source "drivers/staging/picocalc/picocalc_mfd_kbd/Kconfig"
source "drivers/staging/picocalc/picocalc_mfd_led/Kconfig"
source "drivers/staging/picocalc/picocalc_rk3506_rproc/Kconfig"
source "drivers/staging/picocalc/picocalc_snd-m0/Kconfig"

endif
```

## conf/layer.conf
```bitbake
# Layer configuration for meta-picocalc-drivers
# Copyright (C) 2025 Calculinux
# Released under the MIT license (see COPYING.MIT for the terms)

# We have a conf and classes directory, add to BBPATH
BBPATH .= ":${LAYERDIR}"

# We have recipes in various subdirectories, add to BBFILES
BBFILES += "${LAYERDIR}/recipes-*/*/*.bb \
            ${LAYERDIR}/recipes-*/*/*.bbappend"

BBFILE_COLLECTIONS += "meta-picocalc-drivers"
BBFILE_PATTERN_meta-picocalc-drivers = "^${LAYERDIR}/"
BBFILE_PRIORITY_meta-picocalc-drivers = "6"

LAYERDEPENDS_meta-picocalc-drivers = "core"
LAYERSERIES_COMPAT_meta-picocalc-drivers = "walnascar"

# Layer version
LAYERVERSION_meta-picocalc-drivers = "1.0.0"
```

## picocalc_lcd_drm/Kconfig
```kconfig
# SPDX-License-Identifier: GPL-2.0-only

config PICOCALC_LCD_DRM
	tristate "PicoCalc TinyDRM LCD driver"
	depends on DRM && SPI && DRM_MIPI_DBI
	help
	  Enable the TinyDRM-based driver for the PicoCalc ILI9488 SPI
	  panel. This provides a DRM/KMS interface (via mipi-dbi) so
	  userspace can use the kmsdrm backend instead of the legacy
	  framebuffer driver.
```

## recipes-bsp/drivers/picocalc-drivers/files/picocalc/Kconfig
```kconfig
menuconfig STAGING_PICOCALC
    bool "Picocalc staging drivers"
    default n
    help
      This option enables the drivers necessary to support the clockwork
      picocalc, e.g. keyboard and lcd drivers. These drivers were provided by
      hisptoot (https://github.com/hisptoot/picocalc_luckfox_lyra).

if STAGING_PICOCALC

source "drivers/staging/picocalc/picocalc_kbd/Kconfig"
source "drivers/staging/picocalc/picocalc_lcd/Kconfig"
source "drivers/staging/picocalc/picocalc_snd-pwm/Kconfig"
source "drivers/staging/picocalc/picocalc_snd-softpwm/Kconfig"

endif
```
