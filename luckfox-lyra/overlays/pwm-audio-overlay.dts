/dts-v1/;
/plugin/;

/*
 * Device tree overlay for PicoCalc hardware PWM sound
 *
 * Enables the fsl,picocalc-snd-pwm sound device using PWM channels 0 and 1
 * on RM_IO12 / RM_IO13 (GPIO0_B4 / GPIO0_B5, RK3506 pins 12 and 13).
 * Different pins from M0 audio (GPIO4_B2/B3). Pinmux groups already exist
 * in the SoC DT; this overlay only enables the PWM blocks and sound device.
 *
 * To apply at runtime:
 *   mkdir -p /sys/kernel/config/device-tree/overlays/pwm-audio
 *   cat /lib/firmware/overlays/pwm-audio.dtbo > /sys/kernel/config/device-tree/overlays/pwm-audio/dtbo
 *   echo 1 > /sys/kernel/config/device-tree/overlays/pwm-audio/status
 *
 * To remove:
 *   echo 0 > /sys/kernel/config/device-tree/overlays/pwm-audio/status
 *   rmdir /sys/kernel/config/device-tree/overlays/pwm-audio
 */

/ {
    compatible = "rockchip,rk3506";

    fragment@0 {
        target-path = "/";
        __overlay__ {
            picocalc_snd: picocalc-snd {
                status = "okay";
                compatible = "fsl,picocalc-snd-pwm";
                pwm-names = "pwm-snd-left", "pwm-snd-right";
                pwms = <&pwm0_4ch_0 0 25000 0>, <&pwm0_4ch_1 0 25000 0>;
            };
        };
    };

    fragment@1 {
        target = <&pwm0_4ch_0>;
        __overlay__ {
            pinctrl-names = "active";
            pinctrl-0 = <&rm_io12_pwm0_ch0>;
            status = "okay";
            assigned-clocks = <&cru 267>;
            assigned-clock-rates = <100000000>;
        };
    };

    fragment@2 {
        target = <&pwm0_4ch_1>;
        __overlay__ {
            pinctrl-names = "active";
            pinctrl-0 = <&rm_io13_pwm0_ch1>;
            status = "okay";
            assigned-clocks = <&cru 267>;
            assigned-clock-rates = <100000000>;
        };
    };
};
