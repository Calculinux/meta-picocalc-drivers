/dts-v1/;
/plugin/;

/*
 * Device tree overlay for PicoCalc M0 delta-sigma audio
 *
 * Enables the RK3506 Cortex-M0 remoteproc with M0 audio firmware and the
 * picocalc,snd-m0 sound device. Bit-bangs GPIO4_B2/B3 (Lyra pins 31/32,
 * RK3506 pins 138/139). Hardware PWM audio uses GPIO0_B4/B5 (Lyra pins 4/5,
 * RK3506 pins 12/13) instead.
 *
 * m0_shmem and snd_pins are in picocalc-luckfox-lyra.dtsi (base DTB).
 * This overlay only adds the sound and remoteproc devices.
 *
 * To apply at runtime:
 *   mkdir -p /sys/kernel/config/device-tree/overlays/m0-audio
 *   cat /lib/firmware/overlays/m0-audio.dtbo > /sys/kernel/config/device-tree/overlays/m0-audio/dtbo
 *   echo 1 > /sys/kernel/config/device-tree/overlays/m0-audio/status
 *
 * To remove:
 *   echo 0 > /sys/kernel/config/device-tree/overlays/m0-audio/status
 *   rmdir /sys/kernel/config/device-tree/overlays/m0-audio
 */

/ {
    compatible = "rockchip,rk3506";

    fragment@0 {
        target-path = "/";
        __overlay__ {
            picocalc_snd_m0: picocalc-snd-m0 {
                compatible = "picocalc,snd-m0";
                status = "okay";
                memory-region = <&m0_shmem>;
                remote-proc = <&mcu_rproc>;
                ring-buffer-bytes = <8192>;
                pinctrl-names = "default";
                pinctrl-0 = <&snd_pins>;
            };

            mcu_rproc: mcu@fff84000 {
                compatible = "rockchip,rk3506-mcu";
                reg = <0xfff84000 0x8000>;
                firmware-name = "rk3506-m0-audio.elf";
                clocks = <&cru 74>, <&cru 104>,
                         <&cru 76>, <&cru 82>;
                resets = <&cru 90>, <&cru 91>,
                         <&cru 10>;
                reset-names = "h_m0", "m0_jtag", "hresetn_m0_ac";
            };
        };
    };
};
